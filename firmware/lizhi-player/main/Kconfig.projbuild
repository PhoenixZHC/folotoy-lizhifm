## firmware/lizhi-player/main/Kconfig.projbuild
```kconfig
menu "Lizhi player"
config LIZHI_SERIAL_TEST
    bool "Enable local serial acceptance controls (test builds only)"
    default n
config LIZHI_ACCOUNT_USER_ID
    string "Account user ID verified by official website login (not a credential)"
    default ""
config LIZHI_PUBLIC_AUTHOR_ID
    string "Public sample author ID"
    default "5036275272706175532"
config LIZHI_PUBLIC_AUTHOR_NAME
    string "Public sample author name"
    default "出逃在即"
config LIZHI_WIFI_NAMESPACE
    string "Existing Wi-Fi configuration namespace (read only)"
    default "netease_wifi"
endmenu
```

## firmware/lizhi-player/sdkconfig.defaults
```kconfig
CONFIG_IDF_TARGET="esp32c3"
CONFIG_ESPTOOLPY_FLASHSIZE_8MB=y
CONFIG_ESPTOOLPY_HEADER_FLASHSIZE_UPDATE=n
CONFIG_PARTITION_TABLE_CUSTOM=y
CONFIG_PARTITION_TABLE_CUSTOM_FILENAME="../ai-passport/partitions.csv"
CONFIG_ESP_CONSOLE_USB_SERIAL_JTAG=y
CONFIG_ESP_CONSOLE_SECONDARY_NONE=y
CONFIG_ESP_MAIN_TASK_STACK_SIZE=6144
CONFIG_MBEDTLS_CERTIFICATE_BUNDLE=y
CONFIG_MBEDTLS_CERTIFICATE_BUNDLE_DEFAULT_FULL=y
# CONFIG_MBEDTLS_DYNAMIC_BUFFER is not set
CONFIG_MBEDTLS_SSL_IN_CONTENT_LEN=16384
CONFIG_MBEDTLS_SSL_OUT_CONTENT_LEN=1024
# CONFIG_MBEDTLS_SSL_KEEP_PEER_CERTIFICATE is not set
CONFIG_ESP_WIFI_STATIC_RX_BUFFER_NUM=6
CONFIG_ESP_WIFI_DYNAMIC_RX_BUFFER_NUM=12
CONFIG_ESP_WIFI_DYNAMIC_TX_BUFFER_NUM=12
CONFIG_LV_MEM_SIZE_KILOBYTES=24
CONFIG_LV_BUILD_EXAMPLES=n
CONFIG_LV_USE_DEMO_WIDGETS=n
CONFIG_LV_USE_FONT_COMPRESSED=y
CONFIG_LV_USE_QRCODE=y
```

## tools/lizhi_device_probe/main/Kconfig.projbuild
```kconfig
menu "Lizhi read-only device probe"
config LIZHI_PROBE_FOLLOW_OWNER
    string "Website-verified user ID for read-only follow pagination (empty disables)"
    default ""
config LIZHI_PROBE_PLAYBACK
    bool "Play the verified public episode for 30 seconds"
    default n
    help
        Enables real speaker output at volume 25. No account or progress writes.
config LIZHI_PROBE_AUTHOR_ID
    string "Public author ID"
    default "5036275272706175532"
    help
        Real public sample supplied by the user, not an account follow list.
config LIZHI_PROBE_EPISODE_ID
    string "Public episode ID"
    default "3243638952740496390"
config LIZHI_PROBE_WIFI_NAMESPACE
    string "Existing Wi-Fi NVS namespace (read only)"
    default "netease_wifi"
    help
        Read only ssid/password from the reference player's provisioning.
        Does not read account sessions, erase NVS or create configuration.
config LIZHI_PROBE_POSITION
    bool "Validate real seek and local progress persistence"
    default n
    help
        Writes only the real latest local listening position. No account or Wi-Fi writes.
endmenu
```
